; Proyecto reloj.asm
; UNIVERSIDAD DEL VALLE DE GUATEMALA
; Autor : Hector Hugo Oliveros Paiz
; Carne : 22554
; Clase : IE2023 Programacion de microcontroladores
; Seccion : 20
; Proyecto: Reloj
; Hardware: ATMEGA328P



	.include "M328PDEF.inc"
	.cseg

	.org 0x0000 ;Vector RESET
		JMP Main
	.org PCI1addr
		JMP ISR_PCINT1 ;Vector de pin change
	.org OVF0addr   ; Vector de interrupción Timer 0 Overflow
		RJMP ISR_TIMER0

// , 0x83, 0xC6, 0xA1, 0x86, 0x8E
tabla7segAnodo: .DB 0x40, 0x79, 0x24, 0x30, 0x19, 0x12, 0x02, 0x78, 0x00, 0x10 //0,1,2,3,4,5,6,7,8,9
	.equ TOT_ESTADOS=9
	.equ T0VALUE=99
	.def CONTADOR500ms=R18
	.def CONTADOR60S=R19
	.def ESTADO=R22
	.def TEMPORAL=R17
	.def UNIDAD_MIN=R23
	.def DECENA_MIN=R24
	.def UNIDAD_HORA=R25
	.def DECENA_HORA=R26
	.def CONTADOR_DISPLAY=R21
	.def UNIDAD_DIA = R0
	.def DECENA_DIA = R1
	.def UNIDAD_MES = R2
	.def DECENA_MES = R3
	.def ALARMA_UM = R4
	.def ALARMA_DM = R5
	.def ALARMA_UH = R6
	.def ALARMA_DH = R7
	.def ALARMA_ON_OFF = R8

// Configuracion de la pila
	CLI//Desactivar interrupciones globales
Main:
	LDI R16, LOW(RAMEND)
	OUT SPL, R16
	LDI R16, HIGH(RAMEND)
	OUT SPH, R16
//Prescaler
	/*LDI R16, (1<<CLKPCE)
	STS CLKPR, R16
	LDI R16, 0X04
	STS CLKPR, R16*/
//Setup entradas y salidas
	LDI R17, 0X00
	STS UCSR0B, R17 //Desactivar Rx y Tx
	LDI R17, 0XFF
	OUT DDRD, R17// Configurar Puerto D como salida del display
	OUT DDRB, R17// Configurar Puerto B como salida 
	SBI DDRC, PC0
	SBI DDRC, PC1
	SBI DDRC, PC2
	SBI PORTC, PC3; Activando Pull up
	CBI DDRC, PC3; Configurando PC3 como entrada
	SBI PORTC, PC4
	CBI DDRC, PC4 //Configurando PC4 como entrada
	SBI PORTC, PC5
	CBI PORTC, PC5 //Configurando PC5 como entrada
	CBI PINC, PC2
	/*LDI ZL, LOW(tabla7segAnodo<<1)
	LDI ZH, HIGH(tabla7segAnodo<<1)//Configurar tabla en memoria de Z*/
//Config TIMER0
	LDI R16, (1 << CS02) | (1 << CS00)//Prescaler de 1024
    OUT TCCR0B, R16
	LDI R16, (1 << TOIE0)//Habilitar interrupción por overflow
    STS TIMSK0, R16
	LDI R16, T0VALUE
	OUT	TCNT0, R16
//Config PCINT1
	LDI R16, (1 << PCINT11)|(1 << PCINT12)|(1  << PCINT13)
	STS PCMSK1, R16 //Habilitar vectores de interrupcion de los botones
	LDI R16, (1 << PCIE1)
	STS PCICR, R16
//Iniciar registros
	CLR ESTADO
	CLR TEMPORAL
	CLR UNIDAD_MIN
	CLR UNIDAD_HORA
	CLR DECENA_MIN
	CLR DECENA_HORA
	LDI R16, 0X00
	MOV ALARMA_ON_OFF, R16
	LDI R16, 0X08
	MOV UNIDAD_DIA, R16
	LDI R16, 0X01
	MOV DECENA_DIA, R16
	LDI R16, 0X03
	MOV UNIDAD_MES, R16
	LDI R16, 0X00
	MOV DECENA_MES, R16
	MOV ALARMA_UM, R16
	MOV ALARMA_DM, R16
	MOV ALARMA_UH, R16
	MOV ALARMA_DH, R16
	/*LDI R16, 0X05
	MOV ALARMA_US, R16
	LDI R16, 0X01
	MOV ALARMA_DS, R16*/
	SEI //Activar interrupciones globales
//Loop principal
LOOP:
	CPI ESTADO, 0 //Compara estado para saber si esta en modo hora
	BREQ ESTADO_0
	CPI ESTADO, 1//Compara estado para saber si esta en modo fecha
	BREQ RLTVB7
	CPI ESTADO, 2//Compara estado para saber si esta en modo on/off alarma
	BREQ RLTVB8
	CPI ESTADO, 3//Compara estado para saber si esta en modo config.hora.min
	BREQ RLTVB4
	CPI ESTADO, 4//Compara estado para saber si esta en modo config.hora.hora
	BREQ RLTVB1
	CPI ESTADO, 5//Compara estado para saber si esta en modo config.fecha.dia
	BREQ RLTVB2
	CPI ESTADO, 6//Compara estado para saber si esta en modo config.fecha.hora
	BREQ RLTVB3
	CPI ESTADO, 7//Compara estado para saber si esta en modo config.alarma.hora
	BREQ RLTVB5
	CPI ESTADO, 8//Compara estado para saber si esta en modo 
	BREQ RLTVB6
	RJMP LOOP
//Subrutinas
//ESTADOS
RLTVB5:
	RJMP ESTADO_7
RLTVB6:
	RJMP ESTADO_8
RLTVB7:
	RJMP ESTADO_1
RLTVB8:
	RJMP ESTADO_2
ESTADO_0: //modo hora
	OUT PORTC, ESTADO
	CALL ENCENDER_DISPLAYS
	OUT PORTD, R28
	CALL ALARMA
RELOJ:
	CPI CONTADOR500ms, 50//contador para saber si pasaron 500 ms
	BRNE LOOP
	CLR CONTADOR500ms
	SBI PIND, PD7
	INC CONTADOR60S
	CPI CONTADOR60S, 120//contador para saber si pasaron 60 seg
	BRNE LOOP
	CLR CONTADOR60S
	INC UNIDAD_MIN
	CPI UNIDAD_MIN, 10
	BRNE LOOP
	CLR UNIDAD_MIN
	INC DECENA_MIN
	CPI DECENA_MIN, 6
	BRNE LOOP
	CLR DECENA_MIN
	CPI UNIDAD_HORA, 10
	BRNE INC_UHORA
	CLR UNIDAD_HORA
	INC DECENA_HORA
	CPI DECENA_HORA, 3
	BRNE LOOP
	CLR DECENA_HORA
	RJMP LOOP
INC_UHORA:
	LDI TEMPORAL, 2
	CPSE DECENA_HORA, TEMPORAL
	CALL INC_UHORA2
	LDI TEMPORAL, 3
	CPSE UNIDAD_HORA, TEMPORAL
	CALL INC_UHORA2
	CLR UNIDAD_HORA
	CLR DECENA_HORA
	INC UNIDAD_DIA
	RJMP LOOP
RLTVB1:
	RJMP ESTADO_4
RLTVB4:
	RJMP ESTADO_3
INC_UHORA2:
	INC UNIDAD_HORA
	RJMP LOOP
RLTVB2:
	RJMP ESTADO_5
RLTVB3:
	RJMP ESTADO_6
ESTADO_1: //modo fecha
	OUT PORTC, ESTADO
	CALL ENCENDER_DISPLAYS2
	OUT PORTD, R28
	RJMP RELOJ
	RJMP LOOP
ESTADO_2: //modo ON//OFF alarma
	OUT PORTC, ESTADO
	MOV TEMPORAL, ALARMA_ON_OFF
	CPI TEMPORAL, 0X01
	BREQ ENCENDER_ALARMA
	CPI TEMPORAL, 0X00
	BREQ APAGAR_ALARMA
	RJMP LOOP
ESTADO_3: //modo configurar minutos de reloj
	OUT PORTC, ESTADO
	CALL ENCENDER_DISPLAYS
	OUT PORTD, R28
	RJMP LOOP
ESTADO_4://modo configurar horas de reloj
	OUT PORTC, ESTADO
	CALL ENCENDER_DISPLAYS
	OUT PORTD, R28
	RJMP LOOP
ESTADO_5://modo configurar dias de fecha
	OUT PORTC, ESTADO
	CALL ENCENDER_DISPLAYS2
	OUT PORTD, R28
	RJMP LOOP
ESTADO_6: //MODO configurar meses de fecha
	OUT PORTC, ESTADO
	CALL ENCENDER_DISPLAYS2
	OUT PORTD, R28
	RJMP LOOP
ESTADO_7: //modo configurar min alarma
	OUT PORTC, ESTADO
	CALL ENCENDER_DISPLAYS3
	OUT PORTD, R28
	RJMP LOOP
ESTADO_8: //modo configurar hora alarma
	CALL ENCENDER_DISPLAYS3
	OUT PORTD, R28
	RJMP LOOP
ENCENDER_ALARMA:
	IN TEMPORAL, PORTB
	ORI TEMPORAL, (1<<4)
	OUT PORTB, TEMPORAL
	RJMP LOOP
APAGAR_ALARMA:
	IN TEMPORAL, PORTB
	ANDI TEMPORAL, ~(1<<4)
	OUT PORTB, TEMPORAL
	RJMP LOOP
//Subrutinas display
ENCENDER_DISPLAYS:
	CPI CONTADOR_DISPLAY, 0
	BREQ SHOW_DISPLAY1
	CPI CONTADOR_DISPLAY, 1
	BREQ SHOW_DISPLAY2
	CPI CONTADOR_DISPLAY, 2
	BREQ SHOW_DISPLAY3
	CPI CONTADOR_DISPLAY, 3
	BREQ SHOW_DISPLAY4
SHOW_DISPLAY1:
	CBI PORTB, PB3
	CBI PORTB, PB2
	CBI PORTB, PB1
	CBI PORTB, PB0
	LDI ZL, LOW(tabla7segAnodo<<1)
	LDI ZH, HIGH(tabla7segAnodo<<1)
	MOV R16, UNIDAD_MIN
	ADD ZL, R16
	LPM R28, Z
	SBI PORTB, PB3
	RET
SHOW_DISPLAY2:
	CBI PORTB, PB3
	CBI PORTB, PB2
	CBI PORTB, PB1
	CBI PORTB, PB0
	LDI ZL, LOW(tabla7segAnodo<<1)
	LDI ZH, HIGH(tabla7segAnodo<<1)
	MOV R16, DECENA_MIN
	ADD ZL, R16
	LPM R28, Z
	SBI PORTB, PB2
	RET
SHOW_DISPLAY3:
	CBI PORTB, PB3
	CBI PORTB, PB2
	CBI PORTB, PB1
	CBI PORTB, PB0
	LDI ZL, LOW(tabla7segAnodo<<1)
	LDI ZH, HIGH(tabla7segAnodo<<1)
	MOV R16, UNIDAD_HORA
	ADD ZL, R16
	LPM R28, Z
	SBI PORTB, PB1
	RET
SHOW_DISPLAY4:
	CBI PORTB, PB3
	CBI PORTB, PB2
	CBI PORTB, PB1
	CBI PORTB, PB0
	LDI ZL, LOW(tabla7segAnodo<<1)
	LDI ZH, HIGH(tabla7segAnodo<<1)
	MOV R16, DECENA_HORA
	ADD ZL, R16
	LPM R28, Z
	SBI PORTB, PB0
	RET
ENCENDER_DISPLAYS2:
	CPI CONTADOR_DISPLAY, 0
	BREQ SHOW_FECHA1
	CPI CONTADOR_DISPLAY, 1
	BREQ SHOW_FECHA2
	CPI CONTADOR_DISPLAY, 2
	BREQ SHOW_FECHA3
	CPI CONTADOR_DISPLAY, 3
	BREQ SHOW_FECHA4
SHOW_FECHA1:
	CBI PORTB, PB3
	CBI PORTB, PB2
	CBI PORTB, PB1
	CBI PORTB, PB0
	LDI ZL, LOW(tabla7segAnodo<<1)
	LDI ZH, HIGH(tabla7segAnodo<<1)
	MOV R16, UNIDAD_DIA
	ADD ZL, R16
	LPM R28, Z
	SBI PORTB, PB3
	RET
SHOW_FECHA2:
	CBI PORTB, PB3
	CBI PORTB, PB2
	CBI PORTB, PB1
	CBI PORTB, PB0
	LDI ZL, LOW(tabla7segAnodo<<1)
	LDI ZH, HIGH(tabla7segAnodo<<1)
	MOV R16, DECENA_DIA
	ADD ZL, R16
	LPM R28, Z
	SBI PORTB, PB2
	RET
SHOW_FECHA3:
	CBI PORTB, PB3
	CBI PORTB, PB2
	CBI PORTB, PB1
	CBI PORTB, PB0
	LDI ZL, LOW(tabla7segAnodo<<1)
	LDI ZH, HIGH(tabla7segAnodo<<1)
	MOV R16, UNIDAD_MES
	ADD ZL, R16
	LPM R28, Z
	SBI PORTB, PB1
	RET
SHOW_FECHA4:
	CBI PORTB, PB3
	CBI PORTB, PB2
	CBI PORTB, PB1
	CBI PORTB, PB0
	LDI ZL, LOW(tabla7segAnodo<<1)
	LDI ZH, HIGH(tabla7segAnodo<<1)
	MOV R16, DECENA_MES
	ADD ZL, R16
	LPM R28, Z
	SBI PORTB, PB0
	RET
ENCENDER_DISPLAYS3:
	CPI CONTADOR_DISPLAY, 0
	BREQ SHOW_ALARMA1
	CPI CONTADOR_DISPLAY, 1
	BREQ SHOW_ALARMA2
	CPI CONTADOR_DISPLAY, 2
	BREQ SHOW_ALARMA3
	CPI CONTADOR_DISPLAY, 3
	BREQ SHOW_ALARMA4
SHOW_ALARMA1:
	CBI PORTB, PB3
	CBI PORTB, PB2
	CBI PORTB, PB1
	CBI PORTB, PB0
	LDI ZL, LOW(tabla7segAnodo<<1)
	LDI ZH, HIGH(tabla7segAnodo<<1)
	MOV R16, ALARMA_UM
	ADD ZL, R16
	LPM R28, Z
	SBI PORTB, PB3
	RET
SHOW_ALARMA2:
	CBI PORTB, PB3
	CBI PORTB, PB2
	CBI PORTB, PB1
	CBI PORTB, PB0
	LDI ZL, LOW(tabla7segAnodo<<1)
	LDI ZH, HIGH(tabla7segAnodo<<1)
	MOV R16, ALARMA_DM
	ADD ZL, R16
	LPM R28, Z
	SBI PORTB, PB2
	RET
SHOW_ALARMA3:
	CBI PORTB, PB3
	CBI PORTB, PB2
	CBI PORTB, PB1
	CBI PORTB, PB0
	LDI ZL, LOW(tabla7segAnodo<<1)
	LDI ZH, HIGH(tabla7segAnodo<<1)
	MOV R16, ALARMA_UH
	ADD ZL, R16
	LPM R28, Z
	SBI PORTB, PB1
	RET
SHOW_ALARMA4:
	CBI PORTB, PB3
	CBI PORTB, PB2
	CBI PORTB, PB1
	CBI PORTB, PB0
	LDI ZL, LOW(tabla7segAnodo<<1)
	LDI ZH, HIGH(tabla7segAnodo<<1)
	MOV R16, ALARMA_DH
	ADD ZL, R16
	LPM R28, Z
	SBI PORTB, PB0
	RET
//Interrpupcion timer0
ISR_TIMER0:
	PUSH TEMPORAL
	IN TEMPORAL, SREG
	PUSH TEMPORAL

	LDI TEMPORAL, T0VALUE
	OUT TCNT0, TEMPORAL
	SBI TIFR0, TOV0
	INC CONTADOR_DISPLAY
	INC CONTADOR500ms
	CPI CONTADOR_DISPLAY, 4
	BRNE CONTINUAR
	CLR CONTADOR_DISPLAY
CONTINUAR:
	POP TEMPORAL
	OUT SREG, TEMPORAL
	POP TEMPORAL
	RETI
ALARMA: 
	CPSE ALARMA_UM, UNIDAD_MIN
	RET
	CPSE ALARMA_DM, DECENA_MIN
	RET
	CPSE ALARMA_UH, UNIDAD_HORA
	RET
	CPSE ALARMA_DH, DECENA_HORA
	RET
	LDI TEMPORAL, 0X01
	CPSE ALARMA_ON_OFF, TEMPORAL
	RET
	SBI PINB, PB5
	RET
	/*CALL ENCENDER_BUZZER
	RET
ENCENDER_BUZZER:
	SBI PORTC, PC2
	CALL RETARDO
	CBI PORTC, PC2
	CALL RETARDO
	RET
RETARDO:
	LDI TEMPORAL, 200
ESPERA:
	DEC TEMPORAL
	BRNE ESPERA
	RET*/
//Interrrupcion botones
ISR_PCINT1:
	PUSH TEMPORAL ;Guardamos en pila R16
	IN TEMPORAL, SREG
	PUSH TEMPORAL ;Guardamos en pila SREG
	
	SBIC PINC, PC3
	INC ESTADO
	LDI TEMPORAL, TOT_ESTADOS
	CPSE ESTADO, TEMPORAL
	RJMP PC+2
	CLR ESTADO
	CPI ESTADO, 0
	BREQ ESTADO0_ISR
	CPI ESTADO, 1
	BREQ ESTADO1_ISR
	CPI ESTADO, 2
	BREQ ESTADO2_ISR
	CPI ESTADO, 3
	BREQ ESTADO3_ISR
	CPI ESTADO, 4
	BREQ ESTADO4_ISR
	CPI ESTADO, 5
	BREQ ESTADO5_ISR
	CPI ESTADO, 6
	BREQ ESTADO6_ISR
	CPI ESTADO, 7
	BREQ ESTADO7_ISR
	CPI ESTADO, 8
	BREQ ESTADO8_ISR
	RJMP SALIR_ISR//salimos de la interrupcion
ESTADO0_ISR:
	RJMP SALIR_ISR
ESTADO1_ISR:
	RJMP SALIR_ISR
ESTADO2_ISR:
	SBIC PINC, PC4
	LDI TEMPORAL, 0X01
	SBIC PINC, PC5
	CLR TEMPORAL
	CPI TEMPORAL, 0X01
	BREQ ACCION_ALARMA
	CPI TEMPORAL, 0X00
	BREQ ACCION_ALARMA
	RJMP SALIR_ISR
ACCION_ALARMA:
	MOV ALARMA_ON_OFF, TEMPORAL
	RJMP SALIR_ISR
ESTADO3_ISR:
	SBIC PINC, PC4
	RJMP STATE3
	SBIC PINC, PC5
	RJMP STATE3A
	RJMP SALIR_ISR
ESTADO4_ISR:
	SBIC PINC, PC4
	RJMP STATE4
	SBIC PINC, PC5
	RJMP STATE4A
	RJMP SALIR_ISR
ESTADO5_ISR:
	SBIC PINC, PC4
	JMP STATE5
	SBIC PINC, PC5
	JMP STATE5A
	JMP SALIR_ISR
ESTADO6_ISR:
	SBIC PINC, PC4
	JMP STATE6
	SBIC PINC, PC5
	JMP STATE6A
	JMP SALIR_ISR
ESTADO7_ISR:
	SBIC PINC, PC4
	JMP STATE7
	SBIC PINC, PC5
	JMP STATE7A
	RJMP SALIR_ISR
ESTADO8_ISR:
	SBIC PINC, PC4
	JMP STATE8
	SBIC PINC, PC5
	JMP STATE8A
	JMP SALIR_ISR
STATE3:
	LDI TEMPORAL, 9
	CPSE UNIDAD_MIN, TEMPORAL
	RJMP INC_UNIDAD_MIN
	CLR UNIDAD_MIN
	RJMP ESTADO31_ISR
INC_UNIDAD_MIN:
	INC UNIDAD_MIN
	RJMP SALIR_ISR
ESTADO31_ISR:
	LDI TEMPORAL, 5
	CPSE DECENA_MIN, TEMPORAL
	RJMP INC_DECENA_MIN
	CLR DECENA_MIN
	RJMP SALIR_ISR
INC_DECENA_MIN:
	INC DECENA_MIN
	RJMP SALIR_ISR
STATE3A:
	LDI TEMPORAL, 0
	CPSE UNIDAD_MIN, TEMPORAL
	RJMP DEC_UNIDAD_MIN
	LDI UNIDAD_MIN, 9
	RJMP ESTADO32_ISR
DEC_UNIDAD_MIN:
	DEC UNIDAD_MIN
	RJMP SALIR_ISR
ESTADO32_ISR:
	LDI TEMPORAL, 0
	CPSE DECENA_MIN, TEMPORAL
	RJMP DEC_DECENA_MIN
	LDI DECENA_MIN, 5
	RJMP SALIR_ISR
DEC_DECENA_MIN:
	DEC DECENA_MIN
	RJMP SALIR_ISR
STATE4:
	LDI TEMPORAL, 2
	CPSE DECENA_HORA, TEMPORAL
	RJMP INC_UNIDAD_HORA
	LDI TEMPORAL, 3
	CPSE UNIDAD_HORA, TEMPORAL
	RJMP INC_UNIDAD_HORA
	CLR UNIDAD_HORA
	CLR DECENA_HORA
	RJMP SALIR_ISR
INC_UNIDAD_HORA:
	LDI TEMPORAL, 9
	CPSE UNIDAD_HORA, TEMPORAL
	RJMP INC_UHORA_ISR
	CLR UNIDAD_HORA
	INC DECENA_HORA
	RJMP SALIR_ISR
INC_UHORA_ISR:
	INC UNIDAD_HORA
	RJMP SALIR_ISR
STATE4A:
	LDI TEMPORAL, 0
	CPSE DECENA_HORA, TEMPORAL
	RJMP DEC_UNIDAD_HORA
	LDI TEMPORAL, 0
	CPSE UNIDAD_HORA, TEMPORAL
	RJMP DEC_UHORA_ISR
	LDI UNIDAD_HORA, 3
	LDI DECENA_HORA, 2
	RJMP SALIR_ISR
DEC_UNIDAD_HORA:
	LDI TEMPORAL, 0
	CPSE UNIDAD_HORA, TEMPORAL
	RJMP DEC_UHORA_ISR
	LDI UNIDAD_HORA, 9
	DEC DECENA_HORA
	RJMP SALIR_ISR
DEC_UHORA_ISR:
	DEC UNIDAD_HORA
	RJMP SALIR_ISR
STATE5:
	MOV R27, UNIDAD_MES
	CPI R27, 2
	BREQ CHECK_FEB
	CPI R27, 4
	BREQ INC30DU
	CPI R27, 6
	BREQ INC30DU
	CPI R27, 9
	BREQ INC30DU
	MOV R27, DECENA_MES
	CPI R27, 1
	BREQ INC30DU
	JMP INC31DU
CHECK_FEB:
	MOV R27, DECENA_MES
	CPI R27, 0
	BREQ INC_FEBRERO
	JMP INC31DU
INC_FEBRERO:
	LDI TEMPORAL, 2
	CPSE DECENA_DIA, TEMPORAL
	RJMP INC_UNIDAD_FEBRERO
	LDI TEMPORAL, 8
	CPSE UNIDAD_DIA, TEMPORAL
	RJMP INC_UNIDAD_FEBRERO
	CLR UNIDAD_DIA
	CLR DECENA_DIA
	RJMP SALIR_ISR
INC_UNIDAD_FEBRERO:
	LDI TEMPORAL, 9
	CPSE UNIDAD_DIA, TEMPORAL
	RJMP INC_UDIA_FEBRERO
	CLR UNIDAD_DIA
	INC DECENA_DIA
	JMP SALIR_ISR
INC_UDIA_FEBRERO:
	INC UNIDAD_DIA
	JMP SALIR_ISR
INC30DU:
	LDI TEMPORAL, 3
	CPSE DECENA_DIA, TEMPORAL
	RJMP INC_UNIDAD_DIA2
	LDI TEMPORAL, 0
	CPSE UNIDAD_DIA, TEMPORAL
	RJMP INC_UNIDAD_DIA2
	CLR DECENA_DIA
	CLR UNIDAD_DIA
	RJMP SALIR_ISR
INC_UNIDAD_DIA2:
	LDI TEMPORAL, 9
	CPSE UNIDAD_DIA, TEMPORAL
	RJMP INC_UNIDAD_DIA
	CLR UNIDAD_DIA
	INC DECENA_DIA
	RJMP SALIR_ISR
INC_UNIDAD_DIA:
	INC UNIDAD_DIA
	RJMP SALIR_ISR
INC31DU:
	LDI TEMPORAL, 3
	CPSE DECENA_DIA, TEMPORAL
	RJMP INC_UNIDAD_31D
	LDI TEMPORAL, 1
	CPSE UNIDAD_DIA, TEMPORAL
	RJMP INC_UNIDAD_31D
	CLR UNIDAD_DIA
	CLR DECENA_DIA
	RJMP SALIR_ISR
INC_UNIDAD_31D:
	LDI TEMPORAL, 9
	CPSE UNIDAD_DIA, TEMPORAL
	RJMP INC_UNIDAD_DIA
	CLR UNIDAD_DIA
	INC DECENA_DIA
	RJMP SALIR_ISR
STATE5A:
	MOV R27, UNIDAD_MES
	CPI R27, 2
	BREQ CHECK_FEB_DEC
	CPI R27, 4
	BREQ DEC30DU
	CPI R27, 6
	BREQ DEC30DU
	CPI R27, 9
	BREQ DEC30DU
	MOV R27, DECENA_MES
	CPI R27, 1
	BREQ DEC30DU
	JMP DEC31DU
CHECK_FEB_DEC:
	MOV R27, DECENA_MES
	CPI R27, 0
	BREQ DEC_FEBRERO
	JMP DEC31DU
DEC_FEBRERO:
	LDI TEMPORAL, 0
	CPSE DECENA_DIA, TEMPORAL
	RJMP DEC_UNIDAD_FEBRERO
	LDI TEMPORAL, 1
	CPSE UNIDAD_DIA, TEMPORAL
	RJMP DEC_UNIDAD_FEBRERO
	LDI R27, 8
	MOV UNIDAD_DIA, R27
	LDI R27, 2
	MOV DECENA_DIA, R27
	RJMP SALIR_ISR
DEC_UNIDAD_FEBRERO:
	LDI TEMPORAL, 0
	CPSE UNIDAD_DIA, TEMPORAL
	RJMP DEC_UDIA_FEBRERO
	LDI R27, 9
	MOV UNIDAD_DIA, R27
	DEC DECENA_DIA
	JMP SALIR_ISR
DEC_UDIA_FEBRERO:
	DEC UNIDAD_DIA
	JMP SALIR_ISR
DEC30DU:
	LDI TEMPORAL, 0
	CPSE DECENA_DIA, TEMPORAL
	RJMP DEC_UNIDAD_DIA
	LDI TEMPORAL, 1
	CPSE UNIDAD_DIA, TEMPORAL
	RJMP DEC_UNIDAD_DIA
	LDI R27, 0
	MOV UNIDAD_DIA, R27
	LDI R27, 3
	MOV DECENA_DIA, R27
	RJMP SALIR_ISR
DEC_UNIDAD_DIA:
	LDI TEMPORAL, 0
	CPSE UNIDAD_DIA, TEMPORAL
	RJMP DEC_UDIA3
	LDI R27, 9
	MOV UNIDAD_DIA, R27
	DEC DECENA_DIA
	RJMP SALIR_ISR
DEC_UDIA3:
	DEC UNIDAD_DIA
	RJMP SALIR_ISR
DEC31DU:
	LDI TEMPORAL, 0
	CPSE DECENA_DIA, TEMPORAL
	RJMP DEC_UNIDAD_31D
	LDI TEMPORAL, 1
	CPSE UNIDAD_DIA, TEMPORAL
	RJMP DEC_UNIDAD_31D
	LDI R27, 1
	MOV UNIDAD_DIA, R27
	LDI R27, 3
	MOV DECENA_DIA, R27
	RJMP SALIR_ISR
DEC_UNIDAD_31D:
	LDI TEMPORAL, 0
	CPSE UNIDAD_DIA, TEMPORAL
	RJMP DEC_UNIDAD_DIA2
	LDI R27, 9
	MOV UNIDAD_DIA, R27
	DEC DECENA_DIA
	RJMP SALIR_ISR
DEC_UNIDAD_DIA2:
	DEC UNIDAD_DIA
	RJMP SALIR_ISR
SALIR_ISR:
	POP TEMPORAL
	OUT SREG, TEMPORAL
	POP TEMPORAL
	RETI
STATE6:
	LDI TEMPORAL, 1
	CPSE DECENA_MES, TEMPORAL
	RJMP INC_UNIDAD_MES
	LDI TEMPORAL, 2
	CPSE UNIDAD_MES, TEMPORAL
	RJMP INC_UNIDAD_MES
	LDI R27, 1
	MOV UNIDAD_MES, R27
	CLR DECENA_MES
	RJMP SALIR_ISR
INC_UNIDAD_MES:
	LDI TEMPORAL, 9
	CPSE UNIDAD_MES, TEMPORAL
	RJMP INC_UMES_ISR
	CLR UNIDAD_MES
	INC DECENA_MES
	RJMP SALIR_ISR
INC_UMES_ISR:
	INC UNIDAD_MES
	RJMP SALIR_ISR
STATE6A:
	LDI TEMPORAL, 0
	CPSE DECENA_MES, TEMPORAL
	RJMP DEC_UNIDAD_MES
	LDI TEMPORAL, 1
	CPSE UNIDAD_MES, TEMPORAL
	RJMP DEC_UMES_ISR
	LDI R27, 2
	MOV UNIDAD_MES, R27
	LDI R27, 1
	MOV DECENA_MES, R27
	RJMP SALIR_ISR
DEC_UNIDAD_MES:
	LDI TEMPORAL, 1
	CPSE UNIDAD_MES, TEMPORAL
	RJMP DEC_UMES_ISR
	LDI R27, 9
	MOV UNIDAD_MES,R27
	DEC DECENA_MES
	RJMP SALIR_ISR
DEC_UMES_ISR:
	DEC UNIDAD_MES
	RJMP SALIR_ISR
STATE7:
	LDI TEMPORAL, 9
	CPSE ALARMA_UM, TEMPORAL
	RJMP INC_UNIDAD_AUM
	CLR ALARMA_UM
	RJMP ESTADO71_ISR
INC_UNIDAD_AUM:
	INC ALARMA_UM
	RJMP SALIR_ISR
ESTADO71_ISR:
	LDI TEMPORAL, 5
	CPSE ALARMA_DM, TEMPORAL
	RJMP INC_DECENA_ADM
	CLR ALARMA_DM
	RJMP SALIR_ISR
INC_DECENA_ADM:
	INC ALARMA_DM
	RJMP SALIR_ISR
STATE7A:
	LDI TEMPORAL, 0
	CPSE ALARMA_UM, TEMPORAL
	RJMP DEC_UNIDAD_AUM
	LDI R27, 9
	MOV ALARMA_UM, R27
	RJMP ESTADO72_ISR
DEC_UNIDAD_AUM:
	DEC ALARMA_UM
	RJMP SALIR_ISR
ESTADO72_ISR:
	LDI TEMPORAL, 0
	CPSE ALARMA_DM, TEMPORAL
	JMP DEC_DECENA_ADM
	LDI R27, 5
	MOV ALARMA_DM, R27
	RJMP SALIR_ISR
DEC_DECENA_ADM:
	DEC ALARMA_DM
	RJMP SALIR_ISR
STATE8:
	LDI TEMPORAL, 2
	CPSE ALARMA_DH, TEMPORAL
	RJMP INC_UNIDAD_AUH
	LDI TEMPORAL, 3
	CPSE ALARMA_UH, TEMPORAL
	RJMP INC_UNIDAD_AUH
	CLR ALARMA_UH
	CLR ALARMA_DH
	RJMP SALIR_ISR
INC_UNIDAD_AUH:
	LDI TEMPORAL, 9
	CPSE ALARMA_UH, TEMPORAL
	RJMP INC_AUHORA_ISR
	CLR ALARMA_UH
	INC ALARMA_DH
	RJMP SALIR_ISR
INC_AUHORA_ISR:
	INC ALARMA_UH
	RJMP SALIR_ISR
STATE8A:
	LDI TEMPORAL, 0
	CPSE ALARMA_DH, TEMPORAL
	RJMP DEC_UNIDAD_AUH
	LDI TEMPORAL, 0
	CPSE ALARMA_UH, TEMPORAL
	RJMP DEC_AUHORA_ISR
	LDI R27, 3
	MOV ALARMA_UH, R27
	LDI R27, 2
	MOV ALARMA_DH, R27
	RJMP SALIR_ISR
DEC_UNIDAD_AUH:
	LDI TEMPORAL, 0
	CPSE ALARMA_UH, TEMPORAL
	RJMP DEC_AUHORA_ISR
	LDI R27, 9
	MOV ALARMA_UH, R27
	DEC ALARMA_DH
	RJMP SALIR_ISR
DEC_AUHORA_ISR:
	DEC ALARMA_UH
	RJMP SALIR_ISR